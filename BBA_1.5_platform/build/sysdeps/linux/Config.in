## mtk_ApSoC_5020/Uboot-arm/config.in
```kconfig
mainmenu_name 'Uboot Configuration'

choice 'Chip ID'	 "MT7623 MT7623
                   "

choice 'Chip Type' "FPGA FPGA \
                    ASIC ASIC
                   " ASIC

if [ "$MT7623" = "y" ]; then
   if [ "$FPGA" = "y" ]; then
       define_bool MT7623_FPGA_BOARD y
   else
       define_bool MT7623_ASIC_BOARD y
   fi
fi

#########################################################################################3
# MT7623
#########################################################################################3
if [ "$MT7623_FPGA_BOARD" = "y" -o "$MT7623_ASIC_BOARD" = "y" ]; then

#-----------------------
# MT7623 FLASH
#-----------------------
choice 'Flash Type' "NAND ON_BOARD_NAND_FLASH_COMPONENT \
                     SPI ON_BOARD_SPI_FLASH_COMPONENT \
                     eMMC ON_BOARD_EMMC_COMPONENT \
                     SD OFF_BOARD_SD_CARD_COMPONENT 
		    " eMMC

if [ "$ON_BOARD_NAND_FLASH_COMPONENT" = "y" ]; then
define_bool CONFIG_MTK_MTD_NAND y
define_bool CONFIG_MTK_SLC_NAND_SUPPORT y
fi
#-----------------------
# MT7623 DDR
#-----------------------
choice 'DDR Component' "1024Mb ON_BOARD_1024Mb_DRAM_COMPONENT \
			2048Mb ON_BOARD_2048Mb_DRAM_COMPONENT \
			4096Mb ON_BOARD_4096Mb_DRAM_COMPONENT \
			8192Mb ON_BOARD_8192Mb_DRAM_COMPONENT \
			16384Mb ON_BOARD_16384Mb_DRAM_COMPONENT
			" 8192Mb

#-----------------------
# MT7623 Ethernet
#-----------------------			
define_bool PDMA_NEW y
define_bool RX_SCATTER_GATTER_DMA y

choice 'Use GE1 or GE2' "GMAC1 CONFIG_USE_GE1  \
	                 GMAC2 CONFIG_USE_GE2
			"
if [ "$CONFIG_USE_GE1" = "y" ]; then
choice 'GE1 connected to' "GE_MII_FORCE_100	 GE_MII_FORCE_100 \
		           GE_RVMII_FORCE_100    GE_RVMII_FORCE_100 \
		  	   GE_MII_AN		 GE_MII_AN \
		           GE_RGMII_FORCE_1000   GE_RGMII_FORCE_1000 \
		           GE_RGMII_AN		 GE_RGMII_AN \
			   GE_TRGMII_FORCE_2600  CONFIG_GE1_TRGMII_FORCE_2600
			  "
else
choice 'GE2 connected to' " GE_MII_FORCE_100		GE_MII_FORCE_100 \
			    GE_RVMII_FORCE_100		GE_RVMII_FORCE_100 \
  			    GE_MII_AN			GE_MII_AN \
			    GE_RGMII_FORCE_1000		GE_RGMII_FORCE_1000 \
			    GE_RGMII_AN			GE_RGMII_AN \
			    GE_RGMII_INTERNAL_P0_AN	GE_RGMII_INTERNAL_P0_AN \
			    GE_RGMII_INTERNAL_P4_AN	GE_RGMII_INTERNAL_P4_AN 
			   "
fi

if [ "$GE_MII_FORCE_100" = "y" -o \
     "$GE_RVMII_FORCE_100" = "y" ]; then
    define_bool MAC_TO_100SW_MODE y
fi     

if [ "$GE_MII_AN" = "y" -a "$CONFIG_USE_GE1" = "y" ]; then
    define_bool MAC_TO_100PHY_MODE y
    hex "10/100 PHY address for Auto Polling" MAC_TO_GIGAPHY_MODE_ADDR 0x1e
fi
if [ "$GE_MII_AN" = "y" -a "$CONFIG_USE_GE2" = "y" ]; then
    define_bool MAC_TO_100PHY_MODE y
    hex "10/100 PHY address for Auto Polling" MAC_TO_GIGAPHY_MODE_ADDR 0x1f
fi

if [ "$GE_RGMII_FORCE_1000" = "y" -o \
     "$CONFIG_GE1_TRGMII_FORCE_2600" = "y" ]; then
    define_bool  MAC_TO_MT7530_MODE y
fi

if [ "$GE_RGMII_AN" = "y" -a "$CONFIG_USE_GE1" = "y" ]; then
    define_bool  MAC_TO_GIGAPHY_MODE y
    if [ "$MT7623_FPGA_BOARD" = "y" ]; then
        hex "GigaPHY address for Auto Polling" MAC_TO_GIGAPHY_MODE_ADDR 0x5
    else
        hex "GigaPHY address for Auto Polling" MAC_TO_GIGAPHY_MODE_ADDR 0x1e
    fi
fi
if [ "$GE_RGMII_AN" = "y" -a "$CONFIG_USE_GE2" = "y" ]; then
    define_bool  MAC_TO_GIGAPHY_MODE y
    if [ "$MT7623_FPGA_BOARD" = "y" ]; then
        hex "GigaPHY address for Auto Polling" MAC_TO_GIGAPHY_MODE_ADDR 0x6
    else
        hex "GigaPHY address for Auto Polling" MAC_TO_GIGAPHY_MODE_ADDR 0x1f
    fi
fi

if [ "$GE_RGMII_INTERNAL_P0_AN" = "y" -a "$CONFIG_USE_GE2" = "y" ]; then
    define_bool  MAC_TO_GIGAPHY_MODE y
    define_hex   MAC_TO_GIGAPHY_MODE_ADDR 0x0
fi

if [ "$GE_RGMII_INTERNAL_P4_AN" = "y" -a "$CONFIG_USE_GE2" = "y" ]; then
    define_bool  MAC_TO_GIGAPHY_MODE y
    define_hex   MAC_TO_GIGAPHY_MODE_ADDR 0x4
fi
	
fi
```

## mtk_ApSoC_5020/source/config.in
```kconfig
mainmenu_name 'Ralink Embedded Linux Configuration'
mainmenu_option next_comment
comment 'Select the Product you wish to target'
choice 'Ralink Products' "MT7620 CONFIG_DEFAULTS_MEDIATEK_MT7620\
                           MT7621 CONFIG_DEFAULTS_MEDIATEK_MT7621\
                           MT7628 CONFIG_DEFAULTS_MEDIATEK_MT7628\
                           MT7623 CONFIG_DEFAULTS_MEDIATEK_MT7623
                         "
if [ $CONFIG_DEFAULTS_MEDIATEK_MT7620 = "y" ]; then
choice   'Default Configuration File'\
         "2M/16M(AP)	  CONFIG_DEFSETTING_2M16M\
           4M/32M(AP+NAS)	  CONFIG_DEFSETTING_4M32M\
           8M/64M(VOIP/TR069)	  CONFIG_DEFSETTING_8M32M_VOIP\
           8M/64M(FULL)	  CONFIG_DEFSETTING_8M64M
	  "
elif [ $CONFIG_DEFAULTS_MEDIATEK_MT7621 = "y" ]; then
choice   'Default Configuration File'\
         "8M/32M(STA)		CONFIG_DEFSETTING_8M32M\
           8M/64M(AP)		CONFIG_DEFSETTING_8M64M\
           8M/64M(VOIP/TR069)	CONFIG_DEFSETTING_8M16M\
           8M/128M(MT7621+MT7615)	CONFIG_DEFSETTING_8M128M\
           128M/128M(AP+NAS)	CONFIG_DEFSETTING_128M128M
	  "
elif [ $CONFIG_DEFAULTS_MEDIATEK_MT7628 = "y" ]; then
choice   'Default Configuration File'\
         "2M/8M(MT7628KN)  CONFIG_DEFSETTING_2M8M\
           4M/16M(AP)	  CONFIG_DEFSETTING_4M16M\
           4M/32M(AP+NAS)	  CONFIG_DEFSETTING_4M32M\
           8M/64M(FULL)	  CONFIG_DEFSETTING_8M64M
	  "
elif [ $CONFIG_DEFAULTS_MEDIATEK_MT7623 = "y" ]; then
choice   'Default Configuration File'\
          "128M/128M(MT7623A+MT7615_NAND)	CONFIG_DEFSETTING_128M128M\
            256M/256M(MT7623A+MT7615_eMMC)	CONFIG_DEFSETTING_256M256M\
            8G/1G(MT7623N+MT7615_eMMC)	CONFIG_DEFSETTING_8G1G
	  "
fi
endmenu
mainmenu_option next_comment
comment 'Kernel/Library/Defaults Selection'
if [ $CONFIG_DEFAULTS_MEDIATEK_MT7620 = "y" ]; then
choice   'Linux Kernel Version'\
         "2.6.36 CONFIG_DEFAULTS_KERNEL_2_6_36\
           3.10.14 CONFIG_DEFAULTS_KERNEL_3_10_14 
    "2.6.36 
elif [ $CONFIG_DEFAULTS_MEDIATEK_MT7621 = "y" ]; then
choice   'Linux Kernel Version'\
         "2.6.36 CONFIG_DEFAULTS_KERNEL_2_6_36\
           3.10.14 CONFIG_DEFAULTS_KERNEL_3_10_14 
    "2.6.36 
elif [ $CONFIG_DEFAULTS_MEDIATEK_MT7628 = "y" ]; then
choice   'Linux Kernel Version'\
         "2.6.36 CONFIG_DEFAULTS_KERNEL_2_6_36\
           3.10.14 CONFIG_DEFAULTS_KERNEL_3_10_14 
    "2.6.36 
elif [ $CONFIG_DEFAULTS_MEDIATEK_MT7623 = "y" ]; then
 define_bool CONFIG_DEFAULTS_KERNEL_3_10_20 y
fi
if [ $CONFIG_DEFAULTS_KERNEL_3_10_14 = "y" -o $CONFIG_DEFAULTS_MEDIATEK_MT7621 = "y" -o $CONFIG_DEFAULTS_MEDIATEK_MT7628 = "y" ]; then
define_bool CONFIG_UCLIBC_0_9_33_2 y
comment 'uClibc version: 0.9.33.2'
define_string CONFIG_CROSS_COMPILER_PATH /opt/buildroot-gcc463/usr/bin
comment 'Cross Compiler Path: /opt/buildroot-gcc463/usr/bin'
elif [ $CONFIG_DEFAULTS_MEDIATEK_MT7623 = "y" ]; then
define_bool CONFIG_UCLIBC_0_9_33_2 y
comment 'uClibc version: 0.9.33.2'
define_string CONFIG_CROSS_COMPILER_PATH /opt/buildroot-gcc483_arm/usr/bin
comment 'Cross Compiler Path: /opt/buildroot-gcc483_arm/usr/bin'
elif [ $CONFIG_DEFAULTS_MEDIATEK_MT7620 = "y" -a $CONFIG_DEFSETTING_8M32M = "y" ]; then
define_bool CONFIG_UCLIBC_0_9_33_2 y
comment 'uClibc version: 0.9.33.2'
define_string CONFIG_CROSS_COMPILER_PATH /opt/buildroot-gcc463/usr/bin
comment 'Cross Compiler Path: /opt/buildroot-gcc463/usr/bin'
elif [ $CONFIG_DEFAULTS_MEDIATEK_MT7620 = "y" -a $CONFIG_DEFSETTING_8M32M_VOIP = "y" ]; then
define_bool CONFIG_UCLIBC_0_9_33_2 y
comment 'uClibc version: 0.9.33.2'
define_string CONFIG_CROSS_COMPILER_PATH /opt/buildroot-gcc463/usr/bin
else 
define_bool CONFIG_UCLIBC_0_9_28 y
comment 'uClibc version: 0.9.28'
define_string CONFIG_CROSS_COMPILER_PATH /opt/buildroot-gcc342/bin
comment 'Cross Compiler Path: /opt/buildroot-gcc342/bin'
fi
bool 'Have glibc only Apps'       CONFIG_HAVE_GLIBC_APP
if [ $CONFIG_HAVE_GLIBC_APP = "y" ]; then
if [ $CONFIG_DEFAULTS_MEDIATEK_MT7623 = "y" ]; then
define_string CONFIG_CROSS_GLIBC_COMPILER_PATH /opt/buildroot-gcc492_arm_glibc/usr/bin
comment 'glibc Cross-Compiler Path: /opt/buildroot-gcc492_arm_glibc/usr/bin'
else
define_string CONFIG_CROSS_GLIBC_COMPILER_PATH /opt/buildroot-gcc491_mips_glibc/usr/bin
comment 'glibc Cross-Compiler Path: /opt/buildroot-gcc491_mips_glibc/usr/bin'
fi
fi
comment ' '
bool 'Default all settings (lose changes)'	CONFIG_DEFAULTS_OVERRIDE
bool 'Customize Kernel Settings'			CONFIG_DEFAULTS_KERNEL
bool 'Customize Vendor/User Settings'		CONFIG_DEFAULTS_VENDOR
bool 'Customize Busybox Settings'			CONFIG_DEFAULTS_BUSYBOX
bool 'Customize uClibc Settings'			CONFIG_DEFAULTS_UCLIBC
bool 'Customize uClibc++ Settings'		CONFIG_DEFAULTS_UCLIBC_PLUS_PLUS
bool 'Update Default Vendor Settings'		CONFIG_DEFAULTS_VENDOR_UPDATE
endmenu
```

## mtk_ApSoC_5020/source/linux-3.10.14.x/tenderOption/Kconfig
```kconfig
menu "TPLINK Tender Option"

config LAN_WLAN_STA_RATE
	bool "Wireless Negotiating Speed of Clients"
	default n
	help
	  This option can be selected to show the wireless transmit rate.

endmenu
```

## mtk_ApSoC_5020/source/linux-3.10.14.x/tpModel/Kconfig
```kconfig
menu "TPLINK Model"

choice
       prompt "TP-LINK Product MODEL"
       default TP_MODEL_C20V4

config TP_MODEL_C50V3
       bool "Build ArcherC50 V3"

config TP_MODEL_C20V4
       bool "Build ArcherC20 V4"

config TP_MODEL_C5V4
       bool "Build ArcherC5 V4"
	   
config TP_MODEL_WR850NV2
       bool "Build TL-WR850NV2"

config TP_MODEL_WR850NV3
       bool "Build TL-WR850NV3"

config TP_MODEL_EN020_F5V1
       bool "Build EN020-F5V1"
	   
endchoice

config TP_USB_SYSFS
        bool "Support USB sysfs"
        default y

config TPLINK_DRIVER_DEBUG
        bool "Support forwarding packet from one driver to another."
        default n

config TPLINK_QOS_FOR_IPTV
        bool "Support QoS for RU IPTV."
        default n

config TP_CONFIG_RESET
       bool "For Option 66 function: Reset to TP config by pressing reset button."
	   
config ISP_2ND_RESET
       bool "For Option 66 function: Reset to ISP config when press more than 5s and less then 30s, reset to TP config when press more than 30s."
	   
config ISP_CONFIG_OFFSET
       hex "For Option 66 function: Offset of ISP config in flash."
	   default 0x7e0000
	   
endmenu
```
